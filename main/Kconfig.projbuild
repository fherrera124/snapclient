## main/Kconfig.projbuild
```kconfig
menu "Snapclient Configuration"

    config SNAPCLIENT_I2S_BCLK_GPIO
        int "I2S BCK (bit clock) GPIO"
        default 17
        help
            Change to match your own board's wiring via menuconfig.

    config SNAPCLIENT_I2S_WS_GPIO
        int "I2S LRCK (word select) GPIO"
        default 18

    config SNAPCLIENT_I2S_DOUT_GPIO
        int "I2S DIN (data) GPIO"
        default 6

    config SNAPCLIENT_I2S_MCLK_GPIO
        int "I2S MCLK GPIO (-1 if unused)"
        default 0
        help
            A DAC with its own internal PLL doesn't strictly need MCLK,
            but driving it is harmless.

    config SNAPCLIENT_I2S_MUTE_GPIO
        int "DAC mute GPIO (-1 if unused)"
        default -1
        help
            Only needed if the DAC's mute pin is wired to a GPIO rather
            than tied via an onboard pull-up/pull-down (common on cheap
            breakout boards, in which case leave this at -1).

    config SNAPSERVER_HOST
        string "Snapserver host"
        default "192.168.1.1"

    config SNAPSERVER_PORT
        int "Snapserver port"
        default 1704

    config SNAPCLIENT_WEB_PORT
        int "Web server (settings UI + HTTP API) port"
        default 80

    config SNAPCLIENT_DAC_I2C_SDA_GPIO
        int "DAC I2C SDA GPIO (-1 if unused)"
        default -1

    config SNAPCLIENT_DAC_I2C_SCL_GPIO
        int "DAC I2C SCL GPIO (-1 if unused)"
        default -1

    config SNAPCLIENT_DAC_I2C_ADDR
        hex "DAC I2C address"
        default 0x2D

    # espressif/ethernet_init turns the internal EMAC on by default wherever
    # the SoC has one. Nothing is wired to it here, so start from off; the
    # component's own "Ethernet Configuration" menu still turns it on.
    config SNAPCLIENT_ETH_OFF_BY_DEFAULT
        bool
        default y
        select ETHERNET_INIT_DEFAULT_ETH_DISABLED

    config SNAPCLIENT_WIFI_SSID
        string "WiFi SSID (empty to provision over Improv instead)"
        default ""
        help
            Applied on every boot, so it overrides whatever Improv stored.
            Leave empty to keep credentials in NVS.

    config SNAPCLIENT_WIFI_PASSWORD
        string "WiFi password"
        default ""

    config SNAPCLIENT_IMPROV_TIMEOUT_S
        int "Seconds before Improv stops listening (0 = never)"
        default 0
        help
            Frees the provisioning task's 8K stack once the window closes.
            An in-progress provisioning attempt is never cut off.

    config SNAPCLIENT_SNTP_SERVER
        string "SNTP server"
        default "pool.ntp.org"

    config SNAPCLIENT_SNTP_TIMEZONE
        string "Log timestamp timezone (POSIX TZ)"
        default "UTC"
        help
            POSIX TZ string, e.g. "ART3" or "CET-1CEST,M3.5.0,M10.5.0/3".
            Only affects how log timestamps read; nothing in playback or
            sync uses local time.

endmenu
```

## targets/esp32/main/Kconfig.projbuild
```kconfig
menu "Snapclient Configuration"

    config SNAPCLIENT_I2S_BCLK_GPIO
        int "I2S BCK (bit clock) GPIO"
        default 17
        help
            Change to match your own board's wiring via menuconfig.

    config SNAPCLIENT_I2S_WS_GPIO
        int "I2S LRCK (word select) GPIO"
        default 18

    config SNAPCLIENT_I2S_DOUT_GPIO
        int "I2S DIN (data) GPIO"
        default 6

    config SNAPCLIENT_I2S_MCLK_GPIO
        int "I2S MCLK GPIO (-1 if unused)"
        default 0
        help
            PCM5102A has its own internal PLL and doesn't strictly need
            MCLK, but driving it is harmless.

    config SNAPCLIENT_I2S_MUTE_GPIO
        int "PCM5102A XSMT mute GPIO (-1 if unused)"
        default -1
        help
            Only needed if XSMT is wired to a GPIO rather than tied via an
            onboard pull-up (common on cheap breakout boards, in which
            case leave this at -1).

    config SNAPCLIENT_SERVER_HOST
        string "Snapserver host"
        default "192.168.1.1"

    config SNAPCLIENT_SERVER_PORT
        int "Snapserver port"
        default 1704

endmenu
```
